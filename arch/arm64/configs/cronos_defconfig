## arch/arm64/configs/cronos_defconfig
```kconfig
#
#
# Helios defconfig
#
# CONFIG_ALWAYS_PERMISSIVE is not set
CONFIG_MORO_SOUND=y
CONFIG_BOEFFLA_WL_BLOCKER=y
CONFIG_UKSM=y
CONFIG_POWERSUSPEND=y
# CONFIG_POWERSUSPEND_DEBUG is not set
CONFIG_DYNAMIC_FSYNC=y
CONFIG_NET_UDP_TUNNEL=y
CONFIG_WIREGUARD=y
# CONFIG_WIREGUARD_DEBUG is not set
# CONFIG_STORE_MODE is not set
CONFIG_PANEL_SMART_DIMMING=y
CONFIG_WAKE_GESTURES=y
CONFIG_F2FS_FS=y
CONFIG_F2FS_FS_SECURITY=y
# CONFIG_F2FS_CHECK_FS is not set
# CONFIG_F2FS_FS_ENCRYPTION is not set
# CONFIG_F2FS_IO_TRACE
# CONFIG_F2FS_FAULT_INJECTION is not set
```

## arch/arm64/configs/gracer_defconfig
```kconfig
#
# gracerlte_defconfig
#
CONFIG_DEV_RIL_BRIDGE=y
CONFIG_MODEM_PIE_REV=y
CONFIG_MUIC_SUPPORT_CCIC=y
# CONFIG_WLAN_HERO is not set
CONFIG_WLAN_HERO2=y
CONFIG_TOUCHKEY_LIGHT_EFS=y
# CONFIG_KEYBOARD_ABOV_FT16XX_TOUCH is not set
CONFIG_KEYBOARD_THD_CHANGE_AS_FINGERPRINT=y
CONFIG_TOUCHSCREEN_SUPPORT_MULTIMEDIA=y
# CONFIG_TOUCHSCREEN_FTS7 is not set
CONFIG_INPUT_WACOM=y
CONFIG_EPEN_WACOM_W9018=y
CONFIG_CAMERA_SENSOR_5E6_OBJ=y
CONFIG_SECURE_CAMERA_USE=y
# CONFIG_FB_DSU_NOT_SEAMLESS is not set
# CONFIG_FB_DSU_REG_LOCK is not set
CONFIG_LOGGING_BIGDATA_BUG=y
CONFIG_DUMPSTATE_LOGGING=y
CONFIG_CHECK_DECON_TIME=y
# CONFIG_LCD_ESD_IDLE_MODE is not set
# CONFIG_PANEL_S6E3HF4_WQHD is not set
CONFIG_EXYNOS_DECON_LCD_MCD=y
CONFIG_PANEL_S6E3HA5_WQHD=y
# CONFIG_PANEL_S6E3HA3_DYNAMIC is not set
# CONFIG_SUPPORT_CROSS_DOWNLOAD is not set
CONFIG_VDDR_1p5V_ALPM=y
CONFIG_SUPPORT_POC_FLASH=y
# CONFIG_POC_GRACE is not set
CONFIG_PANEL_GRAY_SPOT=y
CONFIG_SND_VERBOSE_PROCFS=y
CONFIG_USB_DEBUG_DETAILED_LOG=y
CONFIG_USB_TYPEC_MANAGER_NOTIFIER=y
CONFIG_USB_ANDROID_SAMSUNG_DISABLE_U1_U2=y
CONFIG_TYPEC=y
CONFIG_LEDS_IRIS_IRLED_SUPPORT=y
CONFIG_RTC_RESET_COUNT=y
CONFIG_SEC_NAD_API=y
CONFIG_CHARGER_DA9155=y
CONFIG_BATTERY_NOTIFIER=y
CONFIG_BATTERY_SAMSUNG_V2=y
# CONFIG_SENSORS_SX9310 is not set
# CONFIG_SENSORS_SSP_TMD4903 is not set
# CONFIG_SENSORS_MAX86902 is not set
# CONFIG_SENSORS_SSP_YAS537 is not set
CONFIG_SENSORS_SSP_MAGNETIC_COMMON=y
CONFIG_SENSORS_SSP_TMD4904=y
CONFIG_SENSORS_SSP_PROX_AUTOCAL_AMS=y
# CONFIG_SENSORS_SSP_PROX_FACTORYCAL is not set
CONFIG_SENSORS_SSP_LIGHT_COLORID=y
CONFIG_SENSORS_SX9320=y
CONFIG_SENSORS_SX9320_NORMAL_TOUCH_THRESHOLD=221
CONFIG_SENSORS_SSP_GRACE=y
CONFIG_SSP_SUPPORT_MAGNETIC_OVERFLOW=y
CONFIG_SENSORS_HRMSENSOR=y
CONFIG_SENSORS_HRM_ADPD143=y
# CONFIG_SENSORS_MAX86900 is not set
# CONFIG_SENSORS_MAX86902 is not set
# CONFIG_SENSORS_ADPD142 is not set
# CONFIG_SENSORS_ADPD143 is not set
# CONFIG_SENSORS_ET320 is not set
# CONFIG_SENSORS_FINGERPRINT_DUALIZATION is not set
CONFIG_SENSORS_FP_TKEY_NOTI=y
CONFIG_SOC_EXYNOS8890_KINIBI311=y
CONFIG_CCIC_NOTIFIER=y
CONFIG_CCIC_S2MM003=y
CONFIG_CCIC_S2MM005=y
CONFIG_CCIC_ALTERNATE_MODE=y
CONFIG_CCIC_LPM_ENABLE=y
# CONFIG_CCIC_WATER_DETECT is not set
```

## arch/arm64/configs/hero2_defconfig
```kconfig
#
# hero2lte_defconfig
#
CONFIG_CMA_AREAS=7
CONFIG_FB_DSU_REG_LOCK=y
CONFIG_EXYNOS_DECON_LCD_MCD=y
# CONFIG_LCD_ESD_IDLE_MODE is not set
CONFIG_PANEL_S6E3HF4_WQHD=y
# CONFIG_PANEL_S6E3HA3_DYNAMIC is not set
# CONFIG_PANEL_DUALIZATION is not set
CONFIG_PREVENT_SWELLING_BATTERY=y
CONFIG_SENSORS_SX9310_NORMAL_TOUCH_THRESHOLD=168
CONFIG_SENSORS_HERO2=y
CONFIG_TOUCHSCREEN_FTS7=y
CONFIG_WAKE_GESTURES=y
CONFIG_MODEL_HERO2LTE=y
# CONFIG_WLAN_HERO is not set
CONFIG_WLAN_HERO2=y
```

## arch/arm64/configs/hero_defconfig
```kconfig
#
# herolte_defconfig
#
# CONFIG_FB_DSU_REG_LOCK is not set
# CONFIG_EXYNOS_DECON_LCD_MCD is not set
CONFIG_LCD_ESD_IDLE_MODE=y
# CONFIG_PANEL_S6E3HF4_WQHD is not set
CONFIG_PANEL_S6E3HA3_DYNAMIC=y
CONFIG_PREVENT_SWELLING_BATTERY=y
CONFIG_SENSORS_SX9310_NORMAL_TOUCH_THRESHOLD=176
# CONFIG_SENSORS_HERO2 is not set
CONFIG_TOUCHSCREEN_FTS7=y
CONFIG_WAKE_GESTURES=y
```

## arch/arm64/configs/oneui_defconfig
```kconfig
#
#
# OneUI defconfig
#
CONFIG_USB_ANDROID_SAMSUNG_MTP=y
# CONFIG_NETFILTER_XT_TARGET_CT is not set
CONFIG_EXFAT_FS=y
CONFIG_FAT_DEFAULT_IOCHARSET="iso8859-1"
# CONFIG_SDFAT_SUPPORT_DIR_SYNC is not set
# CONFIG_SDFAT_CHECK_RO_ATTR is not set
CONFIG_NLS_CODEPAGE_437=y
CONFIG_NLS_ISO8859_1=y
CONFIG_NLS_UTF8=y
```

## arch/arm64/configs/treble-oneui-q_defconfig
```kconfig
#
#
# Treble defconfig
#
CONFIG_USB_ANDROID_SAMSUNG_MTP=y
CONFIG_NETFILTER_XT_TARGET_CT=y
CONFIG_FAT_DEFAULT_IOCHARSET="utf8"
CONFIG_SDFAT_SUPPORT_DIR_SYNC=y
CONFIG_SDFAT_CHECK_RO_ATTR=y
CONFIG_EXT4_FS_POSIX_ACL=y
CONFIG_XFRM_STATISTICS=y
CONFIG_INET_UDP_DIAG=y
CONFIG_HAVE_EBPF_JIT=y
CONFIG_PROC_UID=y
```

## arch/arm64/configs/treble_defconfig
```kconfig
#
#
# Treble defconfig
#
# CONFIG_USB_ANDROID_SAMSUNG_MTP is not set
CONFIG_NETFILTER_XT_TARGET_CT=y
CONFIG_FAT_DEFAULT_IOCHARSET="utf8"
CONFIG_SDFAT_SUPPORT_DIR_SYNC=y
CONFIG_SDFAT_CHECK_RO_ATTR=y
CONFIG_EXT4_FS_POSIX_ACL=y
CONFIG_SDFAT_USE_FOR_VFAT=y
CONFIG_SDFAT_USE_FOR_EXFAT=y
```

## drivers/gud/Kconfig
```kconfig
#
# Mobicore Configuration
#

if SOC_EXYNOS8890
source "drivers/gud/gud-exynos8890/Kconfig"
endif
```

## drivers/usb/typec/Kconfig
```kconfig
menu "USB Power Delivery and Type-C drivers"

config TYPEC
	tristate
	default y if MODEM_PIE_REV
	depends on ANDROID_MAJOR_VERSION != "n"
	depends on ANDROID_MAJOR_VERSION != "o"

endmenu
```
